## ext_tree/package/dlna_bridge/Config.in
```kconfig
config BR2_PACKAGE_DLNA_BRIDGE
	bool "dlna_bridge"
	select BR2_PACKAGE_ALSA_LIB
	help
	  ALSA loopback -> HTTP WAV stream -> DLNA push daemon.
	  Captures audio from snd-aloop and streams it to DLNA renderers.
```

## ext_tree/package/qobuz-connect-assert-hook/Config.in
```kconfig
config BR2_PACKAGE_QOBUZ_CONNECT_ASSERT_HOOK
	bool "qobuz-connect-assert-hook"
	help
	  LD_PRELOAD library that intercepts abort() and __assert_fail()
	  to prevent crashes from assertion failures in libqobuz_connect.
	  
	  This hook converts SIGABRT crashes into graceful exits,
	  which is useful when Qobuz Connect SDK has race conditions
	  that cause assertion failures during stream cleanup.
	  
	  Usage: LD_PRELOAD=/usr/lib/libassert_hook.so /opt/qobuz-connect/qobuz-connect
```

## ext_tree/package/qobuz-connect/Config.in
```kconfig
config BR2_PACKAGE_QOBUZ_CONNECT
	bool "qobuz-connect-dev"
	select BR2_PACKAGE_ALSA_LIB
	select BR2_PACKAGE_AVAHI
	select BR2_PACKAGE_CIVETWEB_LIB
	select BR2_PACKAGE_QOBUZ_CONNECT_ASSERT_HOOK
	help
	  Qobuz Connect for building custom Qobuz Connect players.
	  
	  Includes the sample console application and all required libraries.
	  Automatically includes assert-hook to prevent crashes from
	  assertion failures in libqobuz_connect during stream cleanup.
	  
	  https://qobuz.com/
```

## ext_tree/package/snd-screamalsa/Config.in
```kconfig
config BR2_PACKAGE_SND_SCREAMALSA
	bool "snd-screamalsa"
	depends on BR2_LINUX_KERNEL
	help
	  Virtual ALSA sound card kernel module that streams PCM/DSD
	  audio over the network using the Scream protocol (UDP/TCP).
	  Allows PureFox to stream audio to Windows via AsioScream ASIO.
```
