## ext_tree/Config.in
```kconfig
menu "Audio Renderers"
	source "../ext_tree/package/aprenderer/Config.in"
	source "../ext_tree/package/aplayer/Config.in"
	source "../ext_tree/package/naa/Config.in"
	source "../ext_tree/package/roonready/Config.in"
	source "../ext_tree/package/librespot/Config.in"
	source "../ext_tree/package/apscream/Config.in"
	source "../ext_tree/package/scream/Config.in"
	source "../ext_tree/package/tidalconnect/Config.in"
	source "../ext_tree/package/squeezeliteR2/Config.in"
	source "../ext_tree/package/s2mono/Config.in"
	source "../ext_tree/package/qobuz-cpu-fix/Config.in"
	source "../ext_tree/package/alsa-wrapper/Config.in"
endmenu
```

## ext_tree/package/alsa-wrapper/Config.in
```kconfig
config BR2_PACKAGE_ALSA_WRAPPER
    bool "alsa-wrapper"
    depends on BR2_PACKAGE_ALSA_LIB
    help
      ALSA wrapper library.
      
      This package provides a library that intercepts ALSA calls
      to optimize audio buffer management and provide better
      audio performance for high-resolution audio playback.
      
      Features:
      - Automatic buffer size optimization for high sample rates
      - Volume control and mute functionality
      - Pause/resume emulation
      - Debug logging support
      
comment "alsa-wrapper needs alsa-lib"
    depends on !BR2_PACKAGE_ALSA_LIB
```

## ext_tree/package/qobuz-cpu-fix/Config.in
```kconfig
config BR2_PACKAGE_QOBUZ_CPU_FIX
    bool "qobuz-cpu-fix"
    help
      CPU optimization wrapper for Qobuz Connect.
      
      This package provides a library that intercepts clock_gettime
      calls to reduce CPU usage in Qobuz Connect application by
      implementing time caching mechanism.
      
      The library will be installed to /opt/qobuz-connect/
      
      https://github.com/your-repo/qobuz-cpu-fix
```

## ext_tree/package/raspotify/Config.in
```kconfig
config BR2_PACKAGE_RASPOTIFY
    bool "raspotify"
    help
      Raspotify – это клиент Spotify Connect, основанный на librespot.
```

## ext_tree/package/s2mono/Config.in
```kconfig
config BR2_PACKAGE_S2MONO
    bool "s2mono"
    depends on BR2_PACKAGE_ALSA_LIB
    help
      ALSA plugin for DSD.
      https://github.com/aleev/3308/alsa
```
